## conf/distro/include/init-manager-runit.inc
```bitbake
# Use runit for system initialization
DISTRO_FEATURES_BACKFILL_CONSIDERED:append = " sysvinit systemd"
VIRTUAL-RUNTIME_init_manager ??= "runit"
VIRTUAL-RUNTIME_initscripts ??= "runit-service-scripts"
VIRTUAL-RUNTIME_login_manager ??= "shadow-base"
```

## conf/layer.conf
```bitbake
# We have a conf and classes directory, add to BBPATH
BBPATH .= ":${LAYERDIR}"

# We have a recipes-* directories, add to BBFILES
BBFILES += "${LAYERDIR}/recipes-*/*/*.bb \
            ${LAYERDIR}/recipes-*/*/*.bbappend"

BBFILE_COLLECTIONS += "sysinit-layer"
BBFILE_PATTERN_sysinit-layer = "^${LAYERDIR}/"
BBFILE_PRIORITY_sysinit-layer = "11"

# This should only be incremented on significant changes that will
# cause compatibility issues with other layers
LAYERVERSION_sysinit-layer = "2"

LAYERDEPENDS_sysinit-layer = "core openembedded-layer"
LAYERSERIES_COMPAT_sysinit-layer = "sumo thud warrior zeus"
```
